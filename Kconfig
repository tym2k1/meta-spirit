## Kconfig
```kconfig
# Submenu for selecting MACHINE
menu "Select MACHINE"

choice
    prompt "Choose your target machine"
    default KCONF_MACHINE_CM5
    help
      Pick the machine hardware configuration for the build.

config KCONF_MACHINE_CM5
    bool "spirit-phone-cm5"
    help
      Build for the Spirit Phone CM5 device.

config KCONF_MACHINE_QEMU
    bool "qemuarm64"
    help
      Build for the QEMU ARM64 emulator.

endchoice
endmenu  # end MACHINE submenu

# Submenu for selecting DISTRO
menu "Select DISTRO"

choice
    prompt "Choose your target distro"
    default KCONF_DISTRO_SPIRIT
    help
      Select the Yocto distribution configuration to use.

config KCONF_DISTRO_SPIRIT
    bool "spirit-os"
    help
      Standard Spirit OS distribution.

endchoice
endmenu  # end DISTRO submenu

menu "Features"

config KCONF_FEATURE_DEV_MODE
    bool "Enable Development Features (serial, empty root password)"
    help
      Enable debug/development options in the build:
        - Serial console
        - Empty root password
      Leave disabled for production images.

endmenu  # end Features submenu

menu "Settings Overview"

config KAS_INCLUDE_COMMON
    string "Always include this kas file"
    default "/repo/kas.yml"
    help
      This file is automatically included in the kas build.
      It contains essential base configuration.
      Don't change unless you know what you're doing.

config MACHINE
    string "Selected MACHINE"
    default "spirit-phone-cm5" if KCONF_MACHINE_CM5
    default "qemuarm64" if KCONF_MACHINE_QEMU
	help
	  The end MACHINE value.

config DISTRO
    string "Selected DISTRO"
    default "spirit-os" if KCONF_DISTRO_SPIRIT
	help
	  The end DISTRO value.

config SPIRIT_DEV_MODE
    string "Development Mode flag"
    default "1" if KCONF_FEATURE_DEV_MODE
    default "0"
    help
      This variable will be passed to the Yocto build to enable or disable
      development features in recipes and configuration.

endmenu
```

## conf/distro/spirit-os-dev.conf
```bitbake
require spirit-os.conf

DISTRO_NAME = "SPIRIT OS (Development Image)"

# Enable console through serial for debugging for CM5
ENABLE_UART:spirit-phone-cm5 = "1"
SERIAL_CONSOLES:spirit-phone-cm5 = "115200;ttyAMA0"
IMAGE_INSTALL:append:spirit-phone-cm5 = " sysvinit-inittab"
RPI_EXTRA_CONFIG:spirit-phone-cm5 = "dtoverlay=uart0"

# Empty root password
EXTRA_IMAGE_FEATURES += " empty-root-password"
EXTRA_USERS_PARAMS = "usermod -P '' root;"
```

## conf/distro/spirit-os.conf
```bitbake
DISTRO_NAME = "SPIRIT OS"
DISTRO_VERSION= "0.1"

INIT_MANAGER = "systemd"

# If SPIRIT_DEV_MODE enabled, add development features
# Default to production
SPIRIT_DEV_MODE ?= "0"
OVERRIDES .= ":${@'spirit-dev' if d.getVar('SPIRIT_DEV_MODE') == '1' else ''}"

ENABLE_UART:spirit-phone-cm5:spirit-dev = "1"
SERIAL_CONSOLES:spirit-phone-cm5:spirit-dev = "115200;ttyAMA0"
# IMAGE_INSTALL:append:spirit-phone-cm5:spirit-dev = " sysvinit-inittab"
RPI_EXTRA_CONFIG:spirit-phone-cm5:spirit-dev = "dtoverlay=uart0"
EXTRA_IMAGE_FEATURES:append:spirit-dev = " empty-root-password"
EXTRA_USERS_PARAMS:spirit-dev = "usermod -P '' root"

OVERRIDES .= ":${@'spirit-phosh' if d.getVar('SPIRIT_PHOSH') == '1' else ''}"

DISTRO_FEATURES:append:spirit-phosh = " polkit xwayland wayland pam opengl usrmerge pulseaudio"
IMAGE_INSTALL:append:spirit-phosh = " phosh mutter"

CORE_IMAGE_EXTRA_INSTALL += "wayland weston"

PACKAGECONFIG:append:pn-mesa = " virgl gallium"

# Add packages from kas selection
KCONF_RUNTIME_PACKAGES ??= ""
IMAGE_INSTALL:append = " ${KCONF_RUNTIME_PACKAGES} xkeyboard-config"

DEPENDS:append:pn-phosh = " modemmanager"
```

## conf/distro/spirit_os-dev.conf
```bitbake
require spirit_os.conf

DISTRO_NAME = "SPIRIT OS (Development Image)"

# Enable console through serial for debugging
ENABLE_UART = "1"
SERIAL_CONSOLES = "115200;ttyAMA0"
IMAGE_INSTALL:append = " sysvinit-inittab"
RPI_EXTRA_CONFIG = "dtoverlay=uart0"
```

## conf/distro/spirit_os.conf
```bitbake
DISTRO_NAME = "SPIRIT OS"
DISTRO_VERSION= "0.1"
IMAGE_FSTYPES = "wic.bz2 wic.bmap"
```

## conf/machine/spirit-phone-cm5.conf
```bitbake
require conf/machine/raspberrypi5.conf

MACHINEOVERRIDES =. "spirit-phone-cm5:"

# The CM5 kernel repo uses bcm2712_defconfig
KBUILD_DEFCONFIG = "bcm2712_defconfig"
```

## kas/distro/Kconfig
```kconfig
# Submenu for selecting DISTRO
menu "Select DISTRO"

choice
    prompt "Choose your target distro"
    default KCONF_DISTRO_SPIRIT
    help
      Select the Yocto distribution configuration to use.

config KCONF_DISTRO_SPIRIT
    bool "spirit-os"
    help
      Standard Spirit OS distribution. Poky-based.

endchoice

config DISTRO
    string
    default "spirit-os" if KCONF_DISTRO_SPIRIT

endmenu
```

## kas/features/Kconfig
```kconfig
menu "Features"

config KCONF_FEATURE_DEV_MODE
    bool "Enable Development Features (serial, empty root password)"
    help
      Enable debug/development options in the build:
        - Serial console
        - Empty root password
      Leave disabled for production images.

config KCONF_FEATURE_PHOSH
    bool "Enable Phosh"
    help
      Enable Phosh Desktop Environment

endmenu  # end Features submenu

config SPIRIT_DEV_MODE
    string
    default "1" if KCONF_FEATURE_DEV_MODE
    default "0"

config SPIRIT_PHOSH
    string
    default "1" if KCONF_FEATURE_PHOSH
    default "0"
```

## kas/machine/Kconfig
```kconfig
# Submenu for selecting MACHINE
menu "Select MACHINE"

choice
    prompt "Choose your target machine"
    default KCONF_MACHINE_CM5
    help
      Pick the machine hardware configuration for the build.

config KCONF_MACHINE_CM5
    bool "spirit-phone-cm5"
    help
      Build for the Spirit Phone CM5 device.

config KCONF_MACHINE_QEMU
    bool "qemuarm64"
    help
      Build for the QEMU ARM64 emulator.

endchoice

config MACHINE
    string
    default "spirit-phone-cm5" if KCONF_MACHINE_CM5
    default "qemuarm64" if KCONF_MACHINE_QEMU

endmenu
```

## kas/packages/Kconfig
```kconfig
menu "Packages selection"

config KCONF_RUNTIME_PACKAGES
	string "Runtime packages"
	default "vim"
	help
	  Space-separated list of packages that will be appended to the IMAGE_INSTALL variable.

endmenu
```
